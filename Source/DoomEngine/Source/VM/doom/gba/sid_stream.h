// SPDX-License-Identifier: GPL-2.0-or-later
// MHS modification, 2026-09-14: virtual-cartridge music paths and CRC lookup.
#pragma once
#include "../../abi/vm_abi.h"
#include <string.h>
namespace gbadoomvm {
// Optional, fixed-size, CRC-checked records. No tune code runs on the C64 or
// Teensy, and a late picture never slows the music's wall-clock timeline.
struct SidStream {
    const VmHost *host=nullptr;
    uint32_t handle=0,count=0,loop=0,index=0,last=0;
    bool clocked=false;
    uint8_t value[28]{};
    static uint16_t crc(const uint8_t *p,unsigned n){
        // CCITT lookup trades 512 bytes of available read-only tables for scarce
        // executable RAM, preserving the existing polynomial and initial value.
        static const uint16_t table[256]={
            0x0000,0x1021,0x2042,0x3063,0x4084,0x50a5,0x60c6,0x70e7,
            0x8108,0x9129,0xa14a,0xb16b,0xc18c,0xd1ad,0xe1ce,0xf1ef,
            0x1231,0x0210,0x3273,0x2252,0x52b5,0x4294,0x72f7,0x62d6,
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            0x6e17,0x7e36,0x4e55,0x5e74,0x2e93,0x3eb2,0x0ed1,0x1ef0
        };uint16_t c=65535;while(n--)c=uint16_t((c<<8)^table[(c>>8)^*p++]);return c;
    }
    static uint32_t u32(const uint8_t *p){return uint32_t(p[0])|(uint32_t(p[1])<<8)|(uint32_t(p[2])<<16)|(uint32_t(p[3])<<24);}
    void close(){if(handle)host->close(handle);handle=0;memset(value,0,sizeof value);}
    bool read(uint32_t offset,uint8_t *p,unsigned n){
        while(n){const auto got=host->read(handle,offset,p,n);if(got<=0||unsigned(got)>n)return false;offset+=got;p+=got;n-=got;}return true;
    }
    void open(const VmHost *h,bool ntsc=false){
        close();host=h;clocked=false;index=0;VmFileInfo info{};
        // The host reserves /@ for virtual cartridge roots; legacy roots are /VMS.
        const bool cart=h->package_root&&h->package_root[0]=='/'&&h->package_root[1]=='@';
        static const char *const paths[2][2]={
            {"/VMS/DOOMVM/doom-e1m1-pal.s3m","/VMS/DOOMVM/doom-e1m1-ntsc.s3m"},
            {"/@cart/doom-e1m1-pal.s3m","/@cart/doom-e1m1-ntsc.s3m"}};
        handle=h->open(paths[cart][ntsc],&info);if(!handle)return;
        uint8_t header[32];
        if(info.directory||!read(0,header,32)||u32(header)!=0x4d53334du||
           u32(header+4)!=(0x001c0001u|(uint32_t(ntsc)<<8))||u32(header+8)!=20000||
           crc(header,30)!=(header[30]|header[31]<<8)){close();return;}
        count=u32(header+12);loop=u32(header+16);
        if(!count||count>60000||loop>=count||info.bytes!=32+count*28){close();return;}
        for(unsigned i=20;i<30;i++)if(header[i]){close();return;}
    }
    bool tick(uint32_t now){
        if(!handle)return false;
        uint32_t steps=0;
        if(!clocked){clocked=true;last=now;}
        else{steps=uint32_t(now-last)/20000;if(!steps)return false;last+=steps*20000;
            const uint32_t next=index+steps;index=next<count?next:loop+(next-count)%(count-loop);}
        if(!read(32+index*28,value,28)||value[0]>7||crc(value,26)!=(value[26]|value[27]<<8)){close();return true;}
        if(steps>1)value[0]|=7; // Re-articulate the latest note after a late read.
        return true;
    }
};
}
